#include "device_screen.h"

#include <stddef.h>
#include <stdint.h>
#include <stdio.h>
#include <string.h>
#include "box2_lcd.h"
#include "esp_heap_caps.h"

enum { SCREEN_WIDTH = 240, SCREEN_HEIGHT = 320 };
static uint16_t *s_framebuffer;

static uint16_t rgb565(unsigned r, unsigned g, unsigned b)
{
    const uint16_t color = (uint16_t)(((r & 0xf8) << 8) | ((g & 0xfc) << 3) | (b >> 3));
    return (uint16_t)((color << 8) | (color >> 8));
}

static esp_err_t ensure_framebuffer(void)
{
    if (!s_framebuffer)
    {
        s_framebuffer = heap_caps_malloc(SCREEN_WIDTH * SCREEN_HEIGHT * sizeof(uint16_t),
                                         MALLOC_CAP_SPIRAM | MALLOC_CAP_8BIT);
    }
    return s_framebuffer ? ESP_OK : ESP_ERR_NO_MEM;
}

static void fill_rect(int x, int y, int width, int height, uint16_t color)
{
    if (x < 0) { width += x; x = 0; }
    if (y < 0) { height += y; y = 0; }
    if (width <= 0 || height <= 0 || x >= SCREEN_WIDTH || y >= SCREEN_HEIGHT) return;
    if (width > SCREEN_WIDTH - x) width = SCREEN_WIDTH - x;
    if (height > SCREEN_HEIGHT - y) height = SCREEN_HEIGHT - y;
    for (int row = y; row < y + height; ++row)
    {
        for (int col = x; col < x + width; ++col)
        {
            s_framebuffer[row * SCREEN_WIDTH + col] = color;
        }
    }
}

static void round_rect(int x, int y, int width, int height, int radius, uint16_t color)
{
    if (width <= 0 || height <= 0) return;
    if (radius > width / 2) radius = width / 2;
    if (radius > height / 2) radius = height / 2;
    fill_rect(x + radius, y, width - 2 * radius, height, color);
    fill_rect(x, y + radius, width, height - 2 * radius, color);
    for (int cy = 0; cy < radius; ++cy)
    {
        for (int cx = 0; cx < radius; ++cx)
        {
            const int dx = radius - 1 - cx;
            const int dy = radius - 1 - cy;
            if (dx * dx + dy * dy <= radius * radius)
            {
                fill_rect(x + cx, y + cy, 1, 1, color);
                fill_rect(x + width - 1 - cx, y + cy, 1, 1, color);
                fill_rect(x + cx, y + height - 1 - cy, 1, 1, color);
                fill_rect(x + width - 1 - cx, y + height - 1 - cy, 1, 1, color);
            }
        }
    }
}

static void line(int x0, int y0, int x1, int y1, int thickness, uint16_t color)
{
    const int dx = x1 > x0 ? x1 - x0 : x0 - x1;
    const int sx = x0 < x1 ? 1 : -1;
    const int dy = y1 > y0 ? y0 - y1 : y1 - y0;
    const int sy = y0 < y1 ? 1 : -1;
    int error = dx + dy;
    for (;;)
    {
        fill_rect(x0 - thickness / 2, y0 - thickness / 2, thickness, thickness, color);
        if (x0 == x1 && y0 == y1) break;
        const int doubled = 2 * error;
        if (doubled >= dy) { error += dy; x0 += sx; }
        if (doubled <= dx) { error += dx; y0 += sy; }
    }
}

static const uint8_t *ascii_glyph(char c)
{
    static const uint8_t digits[10][5] = {
        {0x3e, 0x51, 0x49, 0x45, 0x3e},
        {0x00, 0x42, 0x7f, 0x40, 0x00},
        {0x42, 0x61, 0x51, 0x49, 0x46},
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        {0x06, 0x49, 0x49, 0x29, 0x1e},
    };
    static const uint8_t letters[26][5] = {
        {0x7e, 0x11, 0x11, 0x11, 0x7e},
        {0x7f, 0x49, 0x49, 0x49, 0x36},
        {0x3e, 0x41, 0x41, 0x41, 0x22},
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        {0x61, 0x51, 0x49, 0x45, 0x43},
    };
    static const uint8_t space[5] = {0};
    static const uint8_t dash[5] = {0x08, 0x08, 0x08, 0x08, 0x08};
    static const uint8_t dot[5] = {0x00, 0x60, 0x60, 0x00, 0x00};
    static const uint8_t colon[5] = {0x00, 0x36, 0x36, 0x00, 0x00};
    static const uint8_t slash[5] = {0x20, 0x10, 0x08, 0x04, 0x02};
    static const uint8_t percent[5] = {0x62, 0x64, 0x08, 0x13, 0x23};
    static const uint8_t plus[5] = {0x08, 0x08, 0x3e, 0x08, 0x08};
    static const uint8_t equal[5] = {0x14, 0x14, 0x14, 0x14, 0x14};
    if (c >= 'a' && c <= 'z')
        c = (char)(c - 'a' + 'A');
    if (c >= '0' && c <= '9')
        return digits[c - '0'];
    if (c >= 'A' && c <= 'Z')
        return letters[c - 'A'];
    switch (c)
    {
    case '-':
        return dash;
    case '.':
        return dot;
    case ':':
        return colon;
    case '/':
        return slash;
    case '%':
        return percent;
    case '+':
        return plus;
    case '=':
        return equal;
    default:
        return space;
    }
}


typedef struct { uint32_t codepoint; uint16_t small[12]; uint16_t normal[14]; } chinese_glyph_t;
// Only the fixed UI vocabulary is stored; no general-purpose font library.
static const chinese_glyph_t s_chinese_glyphs[] = {
    {0x4e0d, {0x0fff, 0x0040, 0x0060, 0x0030, 0x00f0, 0x0378, 0x066c, 0x0c66, 0x0061, 0x0060, 0x0060, 0x0000}, {0x3fff, 0x0080, 0x00c0, 0x0060, 0x00e0, 0x03f0, 0x06d8, 0x18cc, 0x30c6, 0x00c3, 0x00c0, 0x00c0, 0x0000, 0x0000}}, // 不
    {0x4e32, {0x0060, 0x07fe, 0x0666, 0x07fe, 0x0060, 0x07fe, 0x0462, 0x07fe, 0x0462, 0x0060, 0x0060, 0x0000}, {0x00c0, 0x0ffc, 0x08c4, 0x08c4, 0x0ffc, 0x00c0, 0x1ffe, 0x10c2, 0x10c2, 0x1ffe, 0x00c0, 0x00c0, 0x0000, 0x0000}}, // 串
    {0x4e3a, {0x0024, 0x0028, 0x0020, 0x07fe, 0x0420, 0x0470, 0x0490, 0x0518, 0x0408, 0x0606, 0x03c2, 0x0000}, {0x0044, 0x004c, 0x0048, 0x0040, 0x1ffe, 0x1060, 0x1060, 0x1920, 0x1b30, 0x1818, 0x180c, 0x0f82, 0x0000, 0x0000}}, // 为
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    {0xff0c, {0x000c, 0x0004, 0x0004, 0x0000, 0x0000, 0x0000, 0x0000, 0x0000, 0x0000, 0x0000, 0x0000, 0x0000}, {0x0008, 0x000c, 0x000c, 0x0004, 0x0000, 0x0000, 0x0000, 0x0000, 0x0000, 0x0000, 0x0000, 0x0000, 0x0000, 0x0000}}, // ，
};

static uint32_t next_codepoint(const char **text)
{
    const uint8_t *p = (const uint8_t *)*text;
    uint32_t value = *p;
    size_t bytes = 1;
    if ((p[0] & 0xe0) == 0xc0 && p[1])
    {
        value = ((uint32_t)(p[0] & 0x1f) << 6) | (p[1] & 0x3f);
        bytes = 2;
    }
    else if ((p[0] & 0xf0) == 0xe0 && p[1] && p[2])
    {
        value = ((uint32_t)(p[0] & 0x0f) << 12) | ((uint32_t)(p[1] & 0x3f) << 6) | (p[2] & 0x3f);
        bytes = 3;
    }
    *text += bytes;
    return value;
}

static void draw_glyph(int x, int y, uint32_t codepoint, int font_size, int scale, uint16_t color)
{
    if (codepoint < 128)
    {
        const uint8_t *columns = ascii_glyph((char)codepoint);
        y += (font_size - 7) * scale / 2;
        for (int col = 0; col < 5; ++col)
        {
            for (int row = 0; row < 7; ++row)
            {
                if (columns[col] & (1U << row))
                    fill_rect(x + col * scale, y + row * scale, scale, scale, color);
            }
        }
        return;
    }
    for (size_t i = 0; i < sizeof(s_chinese_glyphs) / sizeof(s_chinese_glyphs[0]); ++i)
    {
        if (s_chinese_glyphs[i].codepoint != codepoint) continue;
        const uint16_t *rows = font_size == 12 ? s_chinese_glyphs[i].small : s_chinese_glyphs[i].normal;
        for (int row = 0; row < font_size; ++row)
        {
            for (int col = 0; col < font_size; ++col)
            {
                if (rows[row] & (1U << col))
                    fill_rect(x + col * scale, y + row * scale, scale, scale, color);
            }
        }
        return;
    }
}

static int text_width(const char *text, int font_size, int scale)
{
    int width = 0;
    while (*text) width += (next_codepoint(&text) < 128 ? 6 : font_size) * scale;
    return width;
}

static void text(int x, int y, const char *caption, int font_size, int scale, uint16_t color)
{
    while (*caption)
    {
        const uint32_t codepoint = next_codepoint(&caption);
        draw_glyph(x, y, codepoint, font_size, scale, color);
        x += (codepoint < 128 ? 6 : font_size) * scale;
    }
}

static void centered(int x, int y, int width, const char *caption, int font_size, int scale, uint16_t color)
{
    text(x + (width - text_width(caption, font_size, scale)) / 2, y, caption, font_size, scale, color);
}

static int clamp(int value, int minimum, int maximum)
{
    return value < minimum ? minimum : value > maximum ? maximum : value;
}

static void header(const device_screen_state_t *state)
{
    const uint16_t foreground = rgb565(238, 244, 250);
    const uint16_t subtle = rgb565(147, 167, 182);
    round_rect(13, 17, 6, 6, 3, rgb565(47, 222, 178));
    text(26, 6, "BOX2", 14, 2, foreground);
    char value[8];
    const int battery = clamp(state->battery_percent, 0, 100);
    if (state->battery_percent < 0) snprintf(value, sizeof(value), "--%%");
    else snprintf(value, sizeof(value), "%d%%", battery);
    text(198 - text_width(value, 12, 1), 11, value, 12, 1, subtle);
    const uint16_t battery_color = battery <= 20 ? rgb565(255, 197, 105) : rgb565(47, 222, 178);
    round_rect(204, 12, 21, 13, 3, subtle);
    round_rect(206, 14, 17, 9, 1, rgb565(12, 18, 25));
    fill_rect(226, 16, 2, 5, subtle);
    if (state->battery_percent >= 0) fill_rect(208, 16, battery * 13 / 100, 5, battery_color);
    if (state->charging)
    {
        line(151, 12, 147, 18, 2, battery_color);
        line(147, 18, 153, 18, 2, battery_color);
        line(153, 18, 149, 24, 2, battery_color);
    }
}

static void chip(int x, int y, const char *caption, uint16_t color, uint16_t background)
{
    round_rect(x, y, 44, 18, 6, background);
    centered(x, y + 3, 44, caption, 12, 1, color);
}

static void microphone_icon(int x, int y, uint16_t color, bool muted)
{
    round_rect(x + 7, y, 12, 21, 6, color);
    round_rect(x + 10, y + 3, 6, 15, 3, rgb565(21, 31, 41));
    line(x + 3, y + 14, x + 3, y + 22, 2, color);
    line(x + 3, y + 22, x + 8, y + 27, 2, color);
    line(x + 8, y + 27, x + 18, y + 27, 2, color);
    line(x + 18, y + 27, x + 23, y + 22, 2, color);
    line(x + 23, y + 22, x + 23, y + 14, 2, color);
    line(x + 13, y + 27, x + 13, y + 32, 2, color);
    line(x + 7, y + 33, x + 19, y + 33, 2, color);
    if (muted)
    {
        line(x - 1, y + 3, x + 27, y + 29, 5, rgb565(21, 31, 41));
        line(x - 1, y + 3, x + 27, y + 29, 2, color);
    }
}

static void microphone_page(const device_screen_state_t *state)
{
    const uint16_t card = rgb565(21, 31, 41);
    const uint16_t foreground = rgb565(238, 244, 250);
    const uint16_t subtle = rgb565(147, 167, 182);
    uint16_t accent = rgb565(47, 222, 178);
    const char *status = state->listening ? "正在录音" : "准备就绪";
    const char *caption = state->listening ? "按M可关闭录音" : "按M可开启录音";
    const char *badge = state->listening ? "LIVE" : "READY";
    if (!state->usb_connected)
    {
        status = "等待连接"; caption = "连接电脑即可使用"; badge = "WAIT";
        accent = rgb565(147, 167, 182);
    }
    if (!state->audio_ready)
    {
        status = "暂不可用"; caption = "请重启设备后重试"; badge = "WAIT";
        accent = rgb565(245, 112, 115);
    }
    round_rect(12, 46, 216, 100, 12, card);
    text(26, 58, "USB 麦克风", 14, 1, subtle);
    chip(171, 58, badge, accent, rgb565(31, 47, 57));
    microphone_icon(30, 87, accent, false);
    centered(63, 87, 150, status, 14, 2, foreground);
    centered(20, 126, 200, caption, 12, 1, subtle);

    const int level = state->listening && state->usb_connected && state->audio_ready
                          ? clamp(state->level_percent, 0, 100) : 0;
    round_rect(12, 156, 216, 58, 12, card);
    text(24, 166, "输入电平", 14, 1, subtle);
    char value[12];
    snprintf(value, sizeof(value), "%d%%", level);
    text(216 - text_width(value, 14, 2), 160, value, 14, 2, foreground);
    const int lit_segments = level ? (level * 32 + 99) / 100 : 0;
    for (int i = 0; i < 32; ++i)
    {
        uint16_t color = rgb565(43, 57, 69);
        if (i < lit_segments)
        {
            color = i >= 29 ? rgb565(245, 112, 115) : i >= 25 ? rgb565(255, 197, 105) : rgb565(47, 222, 178);
        }
        round_rect(24 + i * 6, 192, 4, 11, 1, color);
    }
    round_rect(12, 224, 216, 44, 12, card);
    text(24, 238, "输入增益", 14, 1, subtle);
    snprintf(value, sizeof(value), "%d", clamp(state->gain_db, 0, 42));
    text(191 - text_width(value, 14, 3), 228, value, 14, 3, foreground);
    text(199, 247, "DB", 12, 1, subtle);
}

static void serial_page(const device_screen_state_t *state)
{
    const uint16_t card = rgb565(21, 31, 41);
    const uint16_t foreground = rgb565(238, 244, 250);
    const uint16_t subtle = rgb565(147, 167, 182);
    const uint16_t accent = rgb565(101, 166, 255);
    round_rect(12, 46, 216, 186, 12, card);
    text(26, 58, "USB 串口", 14, 1, subtle);
    chip(171, 58, state->usb_connected ? "READY" : "WAIT", accent, rgb565(31, 47, 57));
    round_rect(83, 91, 74, 47, 8, accent);
    round_rect(86, 94, 68, 41, 6, card);
    line(100, 103, 108, 111, 3, accent);
    line(108, 111, 100, 119, 3, accent);
    line(119, 120, 137, 120, 3, accent);
    centered(12, 151, 216, "串口模式", 14, 2, foreground);
    centered(12, 195, 216, state->usb_connected ? "已连接电脑" : "连接电脑即可通信", 14, 1, subtle);
    centered(12, 249, 216, "长按Q可切换为麦克风", 12, 1, subtle);
}

static void keycap(int x, int y, const char *key)
{
    round_rect(x, y, 14, 14, 4, rgb565(40, 57, 70));
    centered(x, y + 2, 14, key, 12, 1, rgb565(220, 234, 244));
}

static void footer(const device_screen_state_t *state)
{
    const uint16_t subtle = rgb565(147, 167, 182);
    if (state->action != DEVICE_SCREEN_ACTION_NONE)
    {
        const int progress = clamp(state->action_progress_percent, 0, 100);
        const char *caption = state->action == DEVICE_SCREEN_ACTION_POWER_OFF
                                  ? (progress == 100 ? "松开按键后关机" : "继续按住M关机")
                                  : (progress == 100 ? "松开按键后切换" : "继续按住Q切换");
        uint16_t accent = rgb565(47, 222, 178);
        if (state->action == DEVICE_SCREEN_ACTION_POWER_OFF) accent = rgb565(255, 197, 105);
        if (state->action == DEVICE_SCREEN_ACTION_ERROR)
        {
            caption = "操作失败，请重试";
            accent = rgb565(245, 112, 115);
        }
        round_rect(12, 278, 216, 36, 9, rgb565(25, 37, 47));
        centered(12, 284, 216, caption, 12, 1, accent);
        if (state->action != DEVICE_SCREEN_ACTION_ERROR)
        {
            round_rect(24, 304, 192, 3, 1, rgb565(43, 57, 69));
            round_rect(24, 304, 192 * progress / 100, 3, 1, accent);
        }
        return;
    }
    keycap(16, 281, "Q");
    text(36, 282, state->mode == DEVICE_SCREEN_MODE_SERIAL ? "长按转麦克风" : "长按切换", 12, 1, subtle);
    keycap(140, 281, "M");
    text(160, 282, "长按关机", 12, 1, subtle);
    if (state->mode == DEVICE_SCREEN_MODE_MICROPHONE)
    {
        text(16, 302, "L/R", 12, 1, rgb565(220, 234, 244));
        text(42, 302, "调节增益", 12, 1, subtle);
        keycap(140, 301, "M");
        text(160, 302, "短按录音", 12, 1, subtle);
    }
}

esp_err_t device_screen_show(const device_screen_state_t *state)
{
    if (!state || (state->mode != DEVICE_SCREEN_MODE_SERIAL && state->mode != DEVICE_SCREEN_MODE_MICROPHONE))
        return ESP_ERR_INVALID_ARG;
    const esp_err_t err = ensure_framebuffer();
    if (err != ESP_OK) return err;
    fill_rect(0, 0, SCREEN_WIDTH, SCREEN_HEIGHT, rgb565(12, 18, 25));
    header(state);
    if (state->mode == DEVICE_SCREEN_MODE_MICROPHONE) microphone_page(state);
    else serial_page(state);
    footer(state);
    return box2_lcd_draw_bitmap(0, 0, SCREEN_WIDTH, SCREEN_HEIGHT, s_framebuffer);
}

esp_err_t device_screen_show_power_off(void)
{
    const esp_err_t err = ensure_framebuffer();
    if (err != ESP_OK) return err;
    fill_rect(0, 0, SCREEN_WIDTH, SCREEN_HEIGHT, rgb565(12, 18, 25));
    const uint16_t accent = rgb565(147, 167, 182);
    // A power symbol using the same small, dependency-free drawing primitives.
    for (int y = -28; y <= 28; ++y)
    {
        for (int x = -28; x <= 28; ++x)
        {
            const int distance = x * x + y * y;
            if (distance >= 24 * 24 && distance <= 28 * 28 && (y > -20 || x < -10 || x > 10))
                fill_rect(120 + x, 133 + y, 1, 1, accent);
        }
    }
    round_rect(118, 101, 5, 29, 2, accent);
    centered(0, 187, SCREEN_WIDTH, "正在关机", 14, 2, rgb565(238, 244, 250));
    centered(0, 230, SCREEN_WIDTH, "屏幕即将关闭", 14, 1, accent);
    centered(0, 291, SCREEN_WIDTH, "USB供电时短按M唤醒", 12, 1, rgb565(100, 120, 139));
    return box2_lcd_draw_bitmap(0, 0, SCREEN_WIDTH, SCREEN_HEIGHT, s_framebuffer);
}
